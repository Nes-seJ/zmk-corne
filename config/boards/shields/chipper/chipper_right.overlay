
#include "chipper.dtsi"

&default_transform {
	col-offset = <6>;
};

&five_column_transform {
	col-offset = <6>;
};

&kscan0 {
	col-gpios
		= <&gpio1 15 GPIO_ACTIVE_HIGH>	//Col0
		, <&gpio0 31 GPIO_ACTIVE_HIGH>  //Col1
		, <&gpio0 15GPIO_ACTIVE_HIGH>  //Col2
		, <&gpio0 19 GPIO_ACTIVE_HIGH>  //Col3
		, <&gpio1 1 GPIO_ACTIVE_HIGH>  //Col4
		, <&gpio1 0 GPIO_ACTIVE_HIGH>  //Col5
		;
};
