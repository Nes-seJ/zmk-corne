
#include "chipper.dtsi"

&kscan0 {
	col-gpios
		= <&gpio0 4 GPIO_ACTIVE_HIGH>   //Col0
		, <&gpio0 5 GPIO_ACTIVE_HIGH>   //Col1
		, <&gpio1 11 GPIO_ACTIVE_HIGH>   //Col2
		, <&gpio1 12 GPIO_ACTIVE_HIGH>   //Col3
		, <&gpio1 13 GPIO_ACTIVE_HIGH>   //Col4
		, <&gpio1 14t GPIO_ACTIVE_HIGH>   //Col5
		;
};

